## conf/machine/sdx75-idp.conf
```bitbake
#@TYPE: Machine
#@NAME: Qualcomm SDX75 IDP
#@DESCRIPTION: Machine configuration for Qualcomm SDX75 IDP board

require conf/machine/include/qcom-sdx75.inc

KERNEL_DEVICETREE ?= " \
    qcom/sdx75-idp.dtb \
"

# UBI filesystem parameters for NAND flash
MKUBIFS_ARGS ?= "-m 4096 -e 253952 -c 1024"
UBINIZE_ARGS ?= "-m 4096 -p 262144"
```
